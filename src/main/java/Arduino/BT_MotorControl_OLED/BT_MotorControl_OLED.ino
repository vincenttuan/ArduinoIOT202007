#include <AFMotor.h>
#include <SoftwareSerial.h>
#include "U8glib.h"
#include <stdlib.h>
SoftwareSerial BT(9, 10); // 藍芽版的 TX=9, RX=10
AF_DCMotor motor1(1);
AF_DCMotor motor2(2);
AF_DCMotor motor3(3);
AF_DCMotor motor4(4);

U8GLIB_SSD1306_128X64 u8g(U8G_I2C_OPT_NO_ACK);  // 設定OLED類型，這個就是0.96" OLED
//設定圖形1的byte array
const uint8_t rook_bitmap[] PROGMEM = {
  0x00, 0x00, 0x00, 0x00, 0x00, 0x00, 0x00, 0x00, 0x00, 0x00, 0x03, 0x06, 0x00, 0x00, 0x00, 0x00,
  0x11, 0x4A, 0x03, 0x04, 0x00, 0x1F, 0xD0, 0x00, 0x19, 0xEF, 0x06, 0x04, 0x03, 0xDC, 0xF0, 0x00,
  0x7D, 0x4A, 0x0F, 0xCF, 0xE3, 0xC4, 0xD8, 0x00, 0x7D, 0xEF, 0x8F, 0xCF, 0xE2, 0xC4, 0xD8, 0x00,
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  0x00, 0x00, 0x00, 0x00, 0x00, 0x00, 0x00, 0x00, 0x00, 0x00, 0x00, 0x00, 0x00, 0x00, 0x00, 0x00
};

//設定圖形2的byte array
const uint8_t t1[] PROGMEM = {
  0x00, 0x0E, 0x00, 0x00, 0x00, 0xFF, 0xF0, 0x00, 0x01, 0xFF, 0xFC, 0x00, 0x03, 0xFF, 0xFE, 0x00,
  0x0F, 0xFF, 0xFF, 0x80, 0x0F, 0xFF, 0xFF, 0x80, 0x1F, 0xFF, 0xFF, 0xC0, 0x3F, 0xFF, 0xFF, 0xF0,
  0x3F, 0xFF, 0xFF, 0xF0, 0x3F, 0x80, 0x9F, 0xF8, 0x3D, 0x00, 0x6F, 0xFC, 0x71, 0x80, 0x2F, 0xFE,
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  0x00, 0x01, 0xFC, 0x00,
};



int init_speed = 150;
int pre_speed = 0;
int speed = init_speed;
boolean isForward = true;
String val = "";
char val_oled[8];

void setup() {
  Serial.begin(9600);
  BT.begin(9600);
  motor1.run(RELEASE);
  motor2.run(RELEASE);
  motor3.run(RELEASE);
  motor4.run(RELEASE);
  delay(10);
}

void loop() {
  while (BT.available() > 0) {
    val += BT.read();
    delay(2);
  }

  if (val.length() > 0) {
    Serial.println(val);
    
    // String 轉 char[]
    int str_len = val.length() + 1; 
    val.toCharArray(val_oled, str_len);
    
    if (val == "102") { // f
      isForward = true;
      motor1.run(BACKWARD);
      motor2.run(BACKWARD);
      motor3.run(BACKWARD);
      motor4.run(BACKWARD);
      if (speed < init_speed) speed = init_speed;
    } else if (val == "98") { // b
      isForward = false;
      motor1.run(FORWARD);
      motor2.run(FORWARD);
      motor3.run(FORWARD);
      motor4.run(FORWARD);
      if (speed < init_speed) speed = init_speed;
    } else if (val == "108") { // l
      if (isForward) {
        motor1.run(BACKWARD);
        motor2.run(BACKWARD);
        motor3.run(FORWARD);
        motor4.run(FORWARD);
      } else {
        motor1.run(FORWARD);
        motor2.run(FORWARD);
        motor3.run(BACKWARD);
        motor4.run(BACKWARD);
      }
      if (speed < init_speed) speed = init_speed;
    } else if (val == "114") { // r
      if (isForward) {
        motor1.run(FORWARD);
        motor2.run(FORWARD);
        motor3.run(BACKWARD);
        motor4.run(BACKWARD);
      } else {
        motor1.run(BACKWARD);
        motor2.run(BACKWARD);
        motor3.run(FORWARD);
        motor4.run(FORWARD);
      }
    } else if (val == "49") { // 1
      speed += 20;
      if (speed > 255) speed = 255;
    } else if (val == "48") { // 0
      speed -= 20;
      if (speed < 0) speed = 0;
    } else if (val == "112") { // p
      speed = 255;
    } else if (val == "115") { // s
      speed = 0;
    }
    val = "";
  }


  motor1.setSpeed(speed);
  motor2.setSpeed(speed);
  motor3.setSpeed(speed);
  motor4.setSpeed(speed);

  if (pre_speed != speed) {
    Serial.println(speed);
    pre_speed = speed;
  }

  u8g.firstPage();  
  do {
    draw();
  } while( u8g.nextPage() );
  
  // 暫停一段時間後重整畫面
  delay(10);
}

void draw(void) {
  //這個副程式統一處理所有顯示文字和圖片的工作，再讓LOOP呼叫

  u8g.setFont(u8g_font_8x13); //選擇字型
  // int 轉 char[]
  char speed_string[8];
  itoa(speed, speed_string, 10);
  u8g.drawStr( 10, 10, speed_string); //在(0,10)處輸出文字
  
  u8g.setFont(u8g_font_ncenB08); //選擇字型
  u8g.drawStr( 10, 25, val_oled); //在(0,25)處輸出文字
  
  u8g.drawBitmapP( 10, 35, 8, 20, rook_bitmap);  //輸出圖形 x，y，寬(必須是8的倍數)，高，圖形byte array
  u8g.drawBitmapP( 73, 23, 4, 41, t1); //輸出圖形

}
